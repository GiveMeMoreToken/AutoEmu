## scripts/buildroot/external/configs/autoemu_stm32f4_probe_defconfig
```kconfig
BR2_arm=y
BR2_cortex_m4=y
BR2_BINFMT_FLAT=y
BR2_TOOLCHAIN_EXTERNAL=y
BR2_TOOLCHAIN_EXTERNAL_BOOTLIN=y
BR2_TOOLCHAIN_EXTERNAL_BOOTLIN_ARMV7M_UCLIBC_STABLE=y
BR2_TARGET_GENERIC_HOSTNAME="autoemu-stm32f4"
BR2_TARGET_GENERIC_ISSUE="Welcome to AutoEmu STM32F4 probe rootfs"
BR2_TARGET_GENERIC_GETTY_PORT="ttyAMA0"
BR2_INIT_BUSYBOX=y
BR2_ROOTFS_OVERLAY="$(BR2_EXTERNAL_AUTOEMU_PATH)/board/autoemu/stm32f4-probe/rootfs-overlay"
BR2_TARGET_ROOTFS_CPIO=y
```

## scripts/linux/kernel/Kconfig
```kconfig
config AUTOEMU_VIRT_PROBES
	bool "AutoEmu virtual peripheral probes"
	depends on OF && HAS_IOMEM
	default n
	help
	  Built-in probe drivers used by the AutoEmu STM32 Linux validation board.
	  They exercise the virtual ETH, USB OTG FS, and SUBGHZ peripherals during
	  guest boot and print probe results to the kernel log.
```
